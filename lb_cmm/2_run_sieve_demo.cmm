LOCAL &args
ENTRY %LINE &args

LOCAL &cpu
&cpu=STRing.SCANAndExtract("&args","CPU=","MPFS250T-FCVG484-E51")

IF "&cpu"!=""
(
  RESet
  SYStem.CPU &cpu
)
IF CPU()=="NONE"
(
  ECHO %ERROR "No CPU selected! Abort..."
  ENDDO
)

SYStem.CONFIG USOCSMB.BufferBase D:0x3F00000000

SYStem.CONFIG.TPIU Type Generic
SYStem.CONFIG.TPIU ATBSource USOCSMB
TPIU.PortSize 16.
TPIU.PortMode Continuous

SYStem.Mode Up
GOSUB configure_target_registers
Data.LOAD.Elf ~~~~/sieve_ram_e51.elf /Quad /PlusVM /RelPATH

Trace.METHOD Analyzer
Analyzer.Init
Analyzer.state

; run poor man's AutoFocus; We don't have a pattern generator, but TRACE32
; doesn't know that and will try anyways if we're not in running + armed state.
Go.direct
Analyzer.THreshold 1.65
(
	ON ERROR continue
	Analyzer.AutoFocus /NoTHreshold
	PRINT "If the above printed errors, that's probably OK..."
)
Break.direct
Analyzer.Init

Data.LOAD.Elf ~~~~/sieve_ram_e51.elf /Quad /PlusVM /RelPATH

ENDDO

configure_target_registers:
	PRIVATE &mask &amp
	&amp="&"

	; bring up FIC1 interface
	; SYSREG.SUBBLK_CLOCK_CR: Set FIC1 bit
	&mask=1.<<25.
	Data.Set MD:0x20002084 %Long Data.Long(MD:0x20002084)|&mask
	; SYSREG.SOFT_RESET_CR: Clear FIC1 and FPGA bits
	&mask=1.<<25.|1.<<17.
	Data.Set MD:0x20002088 %Long Data.Long(MD:0x20002088)&(amp)~&mask
	PER.Set.simple MD:0x20002010 %Long 1.

	; Prevent MPU errors from trace master
	; MPUCFG.TRACE.PMPCFG_SCB: No idea, just copy what seems to work
	Data.Set MD:0x20005900 %Quad 0x1F00000FFFFFFFFF
	Data.Set MD:0x20005908 %Quad 0x1F00000FFFFFFFFF

	RETURN
