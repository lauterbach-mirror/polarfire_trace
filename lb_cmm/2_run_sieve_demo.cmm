LOCAL &args
ENTRY %LINE &args

LOCAL &cpu
&cpu=STRing.SCANAndExtract("&args","CPU=","MPFS250T-FCVG484-E51")

IF "&cpu"!=""
(
  RESet
  SYStem.CPU &cpu
)
IF CPU()=="NONE"
(
  ECHO %ERROR "No CPU selected! Abort..."
  ENDDO
)

SYStem.CONFIG.USOCCOM.Type AXI
SYStem.CONFIG.USOCCOM.Base D:0x23000000

;me v3.1; api 1; variant 194. (d3u6);
SYStem.CONFIG.USOCME1.Index 0x10
;me v3.1; api 1; variant 195. (d1u5);
SYStem.CONFIG.USOCME2.Index 0x16

SYStem.CONFIG.USOCME1.Flow0_Route 0x1
SYStem.CONFIG.USOCME1.Flow1_Route 0x2
SYStem.CONFIG.USOCME2.Flow0_Route 0x0

;xbm v10.1; api 6; variant 98.;
SYStem.CONFIG.USOCbm.index 0x11

IF CPU()=="MPFS250T-FCVG484-E51"
(
	;rte v1.0; api 0; variant 184. (a2t1);
	SYStem.CONFIG USOCRTE.Index 0x17
)
ELSE IF CPU()=="MPFS250T-FCVG484-U54"
(
	;RTEs for other cores
	IF CORE.NUMBER()==4
	(
		SYStem.CONFIG USOCRTE.index 0x18 0x19 0x1A 0x1B
	)
	ELSE IF CORE.NUMBER()==1
	(
		SYStem.CONFIG USOCRTE.Index 0x18
	)
)
ELSE
(
	ECHO %ERROR "Wrong CPU selected! Abort..."
	ENDDO
)

SYStem.CONFIG USOCSMB.Base D:0x23010000
SYStem.CONFIG USOCSMB.BufferBase D:0x3F00000000

SYStem.CONFIG.TPIU Type Generic
SYStem.CONFIG.TPIU ATBSource USOCSMB
TPIU.PortSize 16.
TPIU.PortMode Continuous

SYStem.Mode Up
Trace.METHOD NONE
; initialize DDR
Go.direct
WAIT 2.s
Break.direct

Data.LOAD.Elf ~~~~/sieve_ram_e51.elf /Quad /PlusVM /RelPATH

Trace.METHOD Analyzer
Analyzer.Init
Analyzer.state

; run poor man's AutoFocus; We don't have a pattern generator, but TRACE32
; doesn't know that and will try anyways if we're not in running + armed state.
Go.direct
Analyzer.THreshold 1.65
(
	ON ERROR continue
	Analyzer.AutoFocus /NoTHreshold
	PRINT "If the above printed errors, that's probably OK..."
)
Break.direct
Analyzer.Init

Data.LOAD.Elf ~~~~/sieve_ram_e51.elf /Quad /PlusVM /RelPATH
